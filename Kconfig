## app_main/src/app_manager/Kconfig
```kconfig
# SPDX-License-Identifier: Apache-2.0

config APP_MANAGER
	bool "App manager"
	depends on ZBUS && APP_LED_SVC
	help
	  Thread that owns the app's services: applies requests from zbus
	  (e.g. LED on/off from BLE) and publishes the resulting state.

if APP_MANAGER

config APP_MANAGER_STACK_SIZE
	int "App manager thread stack size"
	default 2048

config APP_MANAGER_PRIORITY
	int "App manager thread priority"
	default 7

config APP_MANAGER_QUEUE_DEPTH
	int "App manager event queue depth"
	default 8
	help
	  Events waiting for the manager thread. When full, new events are
	  dropped (and counted) rather than blocking the publisher.

module = APP_MANAGER
module-str = app_manager
source "subsys/logging/Kconfig.template.log_config"

endif # APP_MANAGER
```

## app_main/src/debug_shell/Kconfig
```kconfig
# SPDX-License-Identifier: Apache-2.0

config APP_DEBUG_SHELL
	bool "Debug shell commands"
	default y
	depends on SHELL && ZBUS && APP_IDENTITY_SVC && APP_LOAD_CELL_SVC
	help
	  "jkp" shell commands to show and change the device ID and the sample
	  rate, and to show the battery. Debug builds only: the shell is
	  enabled by debug.conf.
```

## app_main/src/emulated_load/Kconfig
```kconfig
# SPDX-License-Identifier: Apache-2.0

config APP_EMULATED_LOAD
	bool "Emulated pulls on the user button"
	depends on JKP_ADS1220_EMUL && $(dt_alias_enabled,sw0)
	help
	  With the ADS1220 emulator in place of the ADC (emulated_adc.conf),
	  holding the user button pulls APP_EMULATED_LOAD_PEAK_KG. In debug
	  builds, "emul raw <code>" holds a fixed ADC code instead (e.g. for
	  calibration with known values) and "emul button" goes back.

config APP_EMULATED_LOAD_PEAK_KG
	int "Emulated pull (kg)"
	default 25
	depends on APP_EMULATED_LOAD
```

## app_main/src/managers/measurement_manager/Kconfig
```kconfig
# SPDX-License-Identifier: Apache-2.0

config APP_MEASUREMENT_MANAGER
	bool "Measurement manager"
	depends on ZBUS && APP_LOAD_CELL_SVC && APP_BLE_SVC && APP_IDENTITY_SVC
	help
	  Thread that answers the Progressor commands from the client (zbus) and,
	  while measuring, samples the load cell and streams the samples to the
	  client in batches.

if APP_MEASUREMENT_MANAGER

config APP_MEASUREMENT_MANAGER_STACK_SIZE
	int "Measurement manager thread stack size"
	default 3072
	help
	  Also saves the calibration factor to settings.

config APP_MEASUREMENT_MANAGER_PRIORITY
	int "Measurement manager thread priority"
	default 2
	help
	  Above the other application threads, so sampling keeps up at high
	  rates. The ADC driver buffers samples meanwhile, and counts the ones
	  it has to overwrite.

config APP_MEASUREMENT_MANAGER_QUEUE_DEPTH
	int "Measurement manager event queue depth"
	default 8
	help
	  Events waiting for the manager thread. When full, new events are
	  dropped (and counted) rather than blocking the publisher.

endif # APP_MEASUREMENT_MANAGER

# Outside "if APP_MEASUREMENT_MANAGER" so the unit test gets the log level too.
module = APP_MEASUREMENT_MANAGER
module-str = measurement_manager
source "subsys/logging/Kconfig.template.log_config"
```

## app_main/src/managers/power_manager/Kconfig
```kconfig
# SPDX-License-Identifier: Apache-2.0

config APP_POWER_MANAGER
	bool "Power manager"
	depends on ZBUS && APP_PMIC_SVC && APP_BLE_SVC && APP_MOTION_SVC && APP_LED_SVC
	help
	  Thread that reads the battery periodically, publishes it
	  (channels::battery), and on a low battery warns the client and puts
	  the PMIC in ship mode. It also tracks inactivity, and after a timeout
	  sleeps until the device is moved; and it drives the status LED.

if APP_POWER_MANAGER

config APP_POWER_MANAGER_STACK_SIZE
	int "Power manager thread stack size"
	default 3072
	help
	  Nordic's fuel gauge library peaks at about 1.6 KB on this thread.

config APP_POWER_MANAGER_PRIORITY
	int "Power manager thread priority"
	default 7
	help
	  Below the measurement manager: battery checks can wait for sampling.

config APP_POWER_MANAGER_IDLE_TIMEOUT_S
	int "Idle time before sleeping, with no client (s)"
	default 240
	help
	  Without commands, connections, measurements starting or stopping,
	  pulls or motion. Crimpdeq's: 4 min.

config APP_POWER_MANAGER_CONNECTED_IDLE_TIMEOUT_S
	int "Idle time before sleeping, with a client connected (s)"
	default 600
	help
	  Long enough for rests between sets (each pull starts it again), while
	  a client left connected, even with a measurement running, can't keep
	  the device awake for ever. Crimpdeq's is 30 min.

config APP_POWER_MANAGER_QUEUE_DEPTH
	int "Power manager event queue depth"
	default 8
	help
	  Events waiting for the manager thread. When full, new events are
	  dropped (and counted) rather than blocking the publisher.

endif # APP_POWER_MANAGER

# Outside "if APP_POWER_MANAGER" so the unit test gets the log level too.
module = APP_POWER_MANAGER
module-str = power_manager
source "subsys/logging/Kconfig.template.log_config"
```

## app_main/src/modules/progressor/test/testcase.yaml
```yaml
tests:
  app_main.progressor.unit:
    harness: gtest
    platform_allow:
      - native_sim
      - native_sim/native/64
    integration_platforms:
      - native_sim/native/64
    tags:
      - unit
      - progressor
```

## app_main/src/services/ble_svc/Kconfig
```kconfig
# SPDX-License-Identifier: Apache-2.0

config APP_BLE_SVC
	bool "BLE service"
	depends on BT_PERIPHERAL && ZBUS && APP_IDENTITY_SVC
	help
	  Bluetooth: connectable advertising as Progressor_NNNN, connections,
	  and the GATT services: the Tindeq Progressor service (control point
	  writes are published to zbus; the measurement manager answers through
	  ble_svc::client()), the JustKeepPulling service, and the standard
	  Device Information (BT_DIS) and Battery (BT_BAS) services.

if APP_BLE_SVC

config APP_BLE_SVC_JKP
	bool "JustKeepPulling service"
	default y
	depends on APP_LOAD_CELL_SVC
	help
	  Our own GATT service, beside the Progressor one: calibration, the
	  sample rate and the full device ID, for any GATT client (e.g. nRF
	  Connect). Requests are published to zbus for the measurement manager.

config APP_BLE_SVC_MAX_QUEUED_NOTIFICATIONS
	int "Data point notifications queued at most"
	default 8
	help
	  Notifications handed to the Bluetooth stack and not yet sent. Beyond
	  this, send_progressor() drops the packet instead of waiting for a
	  buffer, so the measurement manager never blocks on a slow link.
	  BT_ATT_TX_COUNT must cover this plus ble_svc's reserve of 4 buffers
	  for other ATT traffic.

endif # APP_BLE_SVC

# Outside "if APP_BLE_SVC" so the unit test gets the log level too.
module = APP_BLE_SVC
module-str = ble_svc
source "subsys/logging/Kconfig.template.log_config"
```

## app_main/src/services/jkp_svc/Kconfig
```kconfig
# SPDX-License-Identifier: Apache-2.0

config APP_JKP_SVC
	bool "JustKeepPulling service"
	depends on BT_PERIPHERAL && ZBUS && APP_IDENTITY_SVC && APP_LOAD_CELL_SVC
	help
	  Our own GATT service, beside the Progressor one: calibration, the
	  sample rate and the full device ID, for any GATT client (e.g. nRF
	  Connect). Requests are published to zbus for the measurement manager.

# Outside "if APP_JKP_SVC" so the unit test gets the log level too.
module = APP_JKP_SVC
module-str = jkp_svc
source "subsys/logging/Kconfig.template.log_config"
```

## app_main/src/services/led_svc/test/testcase.yaml
```yaml
tests:
  app_main.led_svc.unit:
    harness: gtest
    platform_allow:
      - native_sim
      - native_sim/native/64
    integration_platforms:
      - native_sim/native/64
    tags:
      - unit
      - led_svc
```

## app_main/src/services/load_cell_svc/test/testcase.yaml
```yaml
tests:
  app_main.load_cell_svc.unit:
    harness: gtest
    platform_allow:
      - native_sim
      - native_sim/native/64
    integration_platforms:
      - native_sim/native/64
    tags:
      - unit
      - load_cell_svc
```

## app_main/src/services/motion_svc/Kconfig
```kconfig
# SPDX-License-Identifier: Apache-2.0

config APP_MOTION_SVC
	bool "Motion service"
	depends on SENSOR && GPIO
	help
	  The IMU as a motion detector: whether the device moved, and sleeping
	  (System OFF) until it moves.

if APP_MOTION_SVC

config APP_MOTION_SVC_THRESHOLD_MILLI_G
	int "Motion threshold (mg)"
	default 63
	help
	  The change of acceleration that counts as motion. The LSM6DS3TR-C
	  resolves 1/64 of its +/-2 g range, about 31 mg. To tune on the
	  device: too low and vibration keeps it awake, too high and picking it
	  up doesn't wake it.

endif # APP_MOTION_SVC

# Outside "if APP_MOTION_SVC" so the unit test gets the log level too.
module = APP_MOTION_SVC
module-str = motion_svc
source "subsys/logging/Kconfig.template.log_config"
```

## drivers/Kconfig
```kconfig
# SPDX-License-Identifier: Apache-2.0

menu "just-keep-pulling drivers"

rsource "ads1220/Kconfig"
rsource "npm1300_emul/Kconfig"

endmenu
```

## drivers/ads1220/Kconfig
```kconfig
# SPDX-License-Identifier: Apache-2.0

config JKP_ADS1220
	bool "ADS1220 load-cell ADC"
	default y
	depends on DT_HAS_JKP_ADS1220_ENABLED
	select SPI
	select GPIO
	help
	  Continuous-conversion driver for the TI ADS1220 as a ratiometric
	  load-cell front end (<jkp/drivers/ads1220.h>).

config JKP_ADS1220_INIT_PRIORITY
	int "ADS1220 init priority"
	default 80
	depends on JKP_ADS1220
	help
	  Must be after the SPI and GPIO drivers (by default 70 and 40).

config JKP_ADS1220_EMUL
	bool "ADS1220 emulator"
	default y
	depends on JKP_ADS1220 && EMUL && SPI_EMUL
	select GPIO_EMUL
	help
	  Emulates the ADS1220 on an SPI emulator bus (native_sim): conversions at
	  the configured rate, signalled on an emulated /DRDY pin. Tests set the
	  samples with <jkp/drivers/ads1220_emul.h>.
```

## drivers/npm1300_emul/Kconfig
```kconfig
# SPDX-License-Identifier: Apache-2.0

config JKP_NPM1300_EMUL
	bool "nPM1300 PMIC emulator"
	default y
	depends on DT_HAS_NORDIC_NPM1300_ENABLED && EMUL && I2C_EMUL
	help
	  Emulates the nPM1300's registers on an I2C emulator bus (native_sim),
	  so Zephyr's own MFD, charger and regulator drivers run in tests. The
	  battery measurement and charger state are set with
	  <jkp/drivers/npm1300_emul.h>.
```

## drivers/sensor/temperature_emul/Kconfig
```kconfig
# SPDX-License-Identifier: Apache-2.0

config TEMPERATURE_EMUL
	bool "Emulated temperature sensor"
	default y
	depends on DT_HAS_JKP_TEMPERATURE_EMUL_ENABLED
	help
	  Software temperature sensor for native_sim, reporting
	  SENSOR_CHAN_DIE_TEMP through the regular sensor API. Tests set its
	  value and inject errors with <jkp/drivers/temperature_emul.h>.
```

## dts/bindings/adc/jkp,ads1220.yaml
```yaml
# SPDX-License-Identifier: Apache-2.0

description: |
  TI ADS1220 24-bit ADC wired as a ratiometric load-cell (bridge) front end:
  the reference is REFP0/REFN0 across the bridge excitation. Driven by this
  repo's driver (<jkp/drivers/ads1220.h>), which runs continuous conversions at
  a rate chosen at runtime and reads each sample on the data-ready signal.
  Zephyr's own ti,ads1220 ADC driver only does single-shot conversions at a
  devicetree-fixed rate.

compatible: "jkp,ads1220"

include: spi-device.yaml

properties:
  drdy-gpios:
    type: phandle-array
    required: true
    description: The dedicated /DRDY pin (active low).

  mux:
    type: int
    default: 3
    description: |
      Input multiplexer, the MUX field of register 0. 3 (default) measures
      AIN1 (positive) against AIN2 (negative).

  gain:
    type: int
    default: 128
    enum: [1, 2, 4, 8, 16, 32, 64, 128]
    description: PGA gain.

  low-side-power-switch:
    type: boolean
    description: |
      Close the low-side power switch (AIN3/REFN1 to AVSS) while converting,
      so a bridge returned through AIN3/REFN1 draws no current while the ADC is
      powered down.
```
