## CMakeLists.txt
```
# SPDX-License-Identifier: Apache-2.0

cmake_minimum_required(VERSION 3.20.0)

find_package(Zephyr REQUIRED HINTS $ENV{ZEPHYR_BASE})
project(test_ble_svc)

target_compile_options(app PRIVATE -Werror)

# Only the advertised name and the JustKeepPulling values are unit tested;
# the GATT adapters are covered by the Bumble integration tests (docs/architecture.md, rule 5).
target_include_directories(app PRIVATE
    ../src
    ../../identity_svc/inc
)

target_sources(app PRIVATE
    src/test_advertising.cpp
    src/test_jkp_protocol.cpp
)
```

## prj.conf
```kconfig
# GoogleTest unit test. lib/gtest builds gtest/gmock and provides main();
# Twister runs it with the gtest harness.
CONFIG_GTEST=y

# Same C++ settings as production so test codegen matches.
CONFIG_CPP=y
CONFIG_STD_CPP23=y
CONFIG_REQUIRES_FULL_LIBCPP=y
CONFIG_CPP_EXCEPTIONS=n
CONFIG_CPP_RTTI=n

CONFIG_ASSERT=y
CONFIG_BOOT_BANNER=n

# gtest/gmock need more stack and heap than Zephyr's defaults.
CONFIG_MAIN_STACK_SIZE=32768
CONFIG_HEAP_MEM_POOL_SIZE=131072
```

## src/test_advertising.cpp
```c
/**
 * @file test_advertising.cpp
 * @brief Unit tests of the advertised name.
 *
 * SPDX-License-Identifier: Apache-2.0
 */

#include "advertising.hpp"

#include <gtest/gtest.h>
#include <string_view>

namespace
{

std::string_view as_string( const std::array<char, ble_svc::name_size> &name )
{
    return { name.data() };
}

TEST( AdvertisedName, IsProgressorAndTheLastTwoBytesInDecimal )
{
    EXPECT_EQ( as_string( ble_svc::advertised_name( { 0x7E, 0x4E, 0x17, 0x01, 0x1B, 0xD5 } ) ), "Progressor_7125" ); // 0x1BD5 = 7125
}

TEST( AdvertisedName, PadsWithZeros )
{
    EXPECT_EQ( as_string( ble_svc::advertised_name( { 0xFF, 0xFF, 0xFF, 0xFF, 0x00, 0x07 } ) ), "Progressor_0007" );
}

TEST( AdvertisedName, KeepsFourDigits )
{
    EXPECT_EQ( as_string( ble_svc::advertised_name( { 0, 0, 0, 0, 0xFF, 0xFF } ) ), "Progressor_5535" ); // 65535 % 10000
}

TEST( AdvertisedName, IgnoresTheOtherBytes )
{
    EXPECT_EQ( ble_svc::advertised_name( { 1, 2, 3, 4, 0x12, 0x34 } ), ble_svc::advertised_name( { 9, 8, 7, 6, 0x12, 0x34 } ) );
}

TEST( AdvertisedName, IsNulTerminatedAndFitsLegacyAdvertising )
{
    auto const name = ble_svc::advertised_name( { 0, 0, 0, 0, 0, 0 } );
    EXPECT_EQ( name.back(), '\0' );
    // Flags (3 bytes) and the name's 2-byte header leave 26 bytes of the 31.
    static_assert( ble_svc::name_size - 1 <= 26 );
}

static_assert( ble_svc::advertised_name( { 0, 0, 0, 0, 0x04, 0xD2 } )[14] == '4', "usable at compile time" );

} // namespace
```

## src/test_battery_level.cpp
```c
/**
 * @file test_battery_level.cpp
 * @brief Unit tests of the battery level estimate.
 *
 * SPDX-License-Identifier: Apache-2.0
 */

#include "battery_level.hpp"

#include <gtest/gtest.h>

namespace
{

using ble_svc::battery_level_percent;

TEST( BatteryLevel, EmptyAtThePowerOffVoltageAndBelow )
{
    EXPECT_EQ( battery_level_percent( 3300 ), 0 );
    EXPECT_EQ( battery_level_percent( 0 ), 0 );
}

TEST( BatteryLevel, FullAtTheChargeVoltageAndAbove )
{
    EXPECT_EQ( battery_level_percent( 4200 ), 100 );
    EXPECT_EQ( battery_level_percent( 4350 ), 100 );
}

TEST( BatteryLevel, FollowsTheCurve )
{
    EXPECT_EQ( battery_level_percent( 3750 ), 25 );
    EXPECT_EQ( battery_level_percent( 3900 ), 65 );
    EXPECT_EQ( battery_level_percent( 3950 ), 72 ); // halfway from 65 to 80
}

TEST( BatteryLevel, NeverDecreasesWithVoltage )
{
    unsigned previous = 0;
    for( std::uint32_t mv = 3000; mv <= 4400; mv += 10 ) {
        unsigned const level = battery_level_percent( mv );
        EXPECT_GE( level, previous ) << mv << " mV";
        previous = level;
    }
}

static_assert( battery_level_percent( 4100 ) == 92, "usable at compile time" );

} // namespace
```

## src/test_gatt_codec.cpp
```c
/**
 * @file test_gatt_codec.cpp
 * @brief Unit tests for the BLE service's characteristic encoding and validation.
 *
 * SPDX-License-Identifier: Apache-2.0
 */

#include "gatt_codec.hpp"

#include <array>
#include <cstdint>
#include <gtest/gtest.h>
#include <limits>
#include <span>

using ble_svc::AttError;

namespace
{

TEST( DecodeLedWriteTest, AcceptsZeroAndOne )
{
    constexpr std::array<std::uint8_t, 1> off{ 0 };
    constexpr std::array<std::uint8_t, 1> on{ 1 };

    EXPECT_EQ( ble_svc::decode_led_write( off, 0 ), false );
    EXPECT_EQ( ble_svc::decode_led_write( on, 0 ), true );
}

TEST( DecodeLedWriteTest, RejectsOtherValues )
{
    constexpr std::array<std::uint8_t, 1> two{ 2 };
    constexpr std::array<std::uint8_t, 1> max{ 0xFF };

    EXPECT_EQ( ble_svc::decode_led_write( two, 0 ).error(), AttError::value_not_allowed );
    EXPECT_EQ( ble_svc::decode_led_write( max, 0 ).error(), AttError::value_not_allowed );
}

TEST( DecodeLedWriteTest, RejectsWrongLength )
{
    constexpr std::array<std::uint8_t, 2> two_bytes{ 1, 0 };

    EXPECT_EQ( ble_svc::decode_led_write( std::span<const std::uint8_t>{}, 0 ).error(), AttError::invalid_attribute_length );
    EXPECT_EQ( ble_svc::decode_led_write( two_bytes, 0 ).error(), AttError::invalid_attribute_length );
}

TEST( DecodeLedWriteTest, RejectsNonZeroOffset )
{
    constexpr std::array<std::uint8_t, 1> on{ 1 };

    EXPECT_EQ( ble_svc::decode_led_write( on, 1 ).error(), AttError::invalid_offset );
}

TEST( EncodeTest, LedState )
{
    EXPECT_EQ( ble_svc::encode_led_state( false ), ( std::array<std::uint8_t, 1>{ 0 } ) );
    EXPECT_EQ( ble_svc::encode_led_state( true ), ( std::array<std::uint8_t, 1>{ 1 } ) );
}

TEST( EncodeTest, TemperatureIsLittleEndianInt16 )
{
    EXPECT_EQ( ble_svc::encode_temperature( 2537 ), ( std::array<std::uint8_t, 2>{ 0xE9, 0x09 } ) );
    EXPECT_EQ( ble_svc::encode_temperature( -1 ), ( std::array<std::uint8_t, 2>{ 0xFF, 0xFF } ) );
    EXPECT_EQ( ble_svc::encode_temperature( std::numeric_limits<std::int16_t>::min() ), ( std::array<std::uint8_t, 2>{ 0x00, 0x80 } ) );
}

} // namespace
```

## src/test_jkp_protocol.cpp
```c
/**
 * @file test_jkp_protocol.cpp
 * @brief The JustKeepPulling service's characteristic values.
 *
 * SPDX-License-Identifier: Apache-2.0
 */

#include "jkp_protocol.hpp"

#include <array>
#include <bit>
#include <cstdint>
#include <gtest/gtest.h>
#include <limits>

namespace
{

using ble_svc::jkp::decode_calibration_kg;
using ble_svc::jkp::decode_reset_calibration;
using ble_svc::jkp::decode_sample_rate;
using ble_svc::jkp::encode_calibration;
using ble_svc::jkp::encode_sample_rate;

std::array<std::uint8_t, 4> f32_bytes( float value )
{
    auto const bits = std::bit_cast<std::uint32_t>( value );
    return { static_cast<std::uint8_t>( bits ), static_cast<std::uint8_t>( bits >> 8U ), static_cast<std::uint8_t>( bits >> 16U ),
             static_cast<std::uint8_t>( bits >> 24U ) };
}

TEST( JkpProtocol, EncodesTheCalibration )
{
    // 1.5f is 0x3FC00000.
    EXPECT_EQ( encode_calibration( 1, 3, 1.5F ), ( std::array<std::uint8_t, 6>{ 0x01, 0x03, 0x00, 0x00, 0xC0, 0x3F } ) );
}

TEST( JkpProtocol, DecodesACalibrationWeight )
{
    auto const bytes = f32_bytes( 20.5F );
    EXPECT_EQ( decode_calibration_kg( bytes ), 20.5F );
    auto const zero = f32_bytes( 0.0F );
    EXPECT_EQ( decode_calibration_kg( zero ), 0.0F );
}

TEST( JkpProtocol, RejectsAWeightOfTheWrongLength )
{
    constexpr std::array<std::uint8_t, 3> short_value{ 0x00, 0x00, 0xA4 };
    EXPECT_EQ( decode_calibration_kg( short_value ), std::unexpected( std::errc::message_size ) );
    constexpr std::array<std::uint8_t, 5> long_value{};
    EXPECT_EQ( decode_calibration_kg( long_value ), std::unexpected( std::errc::message_size ) );
}

TEST( JkpProtocol, RejectsNegativeAndNonFiniteWeights )
{
    for( float const kg :
         { -1.0F, std::numeric_limits<float>::infinity(), -std::numeric_limits<float>::infinity(), std::numeric_limits<float>::quiet_NaN() } ) {
        auto const bytes = f32_bytes( kg );
        EXPECT_EQ( decode_calibration_kg( bytes ), std::unexpected( std::errc::invalid_argument ) ) << kg;
    }
}

TEST( JkpProtocol, ResetTakesOnlyItsValue )
{
    constexpr std::array<std::uint8_t, 1> reset{ 0x01 };
    EXPECT_TRUE( decode_reset_calibration( reset ) );
    constexpr std::array<std::uint8_t, 1> other{ 0x00 };
    EXPECT_EQ( decode_reset_calibration( other ), std::unexpected( std::errc::invalid_argument ) );
    constexpr std::array<std::uint8_t, 2> too_long{ 0x01, 0x01 };
    EXPECT_EQ( decode_reset_calibration( too_long ), std::unexpected( std::errc::message_size ) );
    EXPECT_EQ( decode_reset_calibration( {} ), std::unexpected( std::errc::message_size ) );
}

TEST( JkpProtocol, EncodesTheSampleRate )
{
    EXPECT_EQ( encode_sample_rate( hal::SampleRate::sps1000 ), ( std::array<std::uint8_t, 2>{ 0xE8, 0x03 } ) );
}

TEST( JkpProtocol, DecodesEverySampleRate )
{
    for( hal::SampleRate const rate : hal::all_sample_rates ) {
        auto const bytes = encode_sample_rate( rate );
        EXPECT_EQ( decode_sample_rate( bytes ), rate );
    }
}

TEST( JkpProtocol, RejectsAnUnsupportedSampleRate )
{
    constexpr std::array<std::uint8_t, 2> hundred{ 100, 0 };
    EXPECT_EQ( decode_sample_rate( hundred ), std::unexpected( std::errc::not_supported ) );
    constexpr std::array<std::uint8_t, 1> short_value{ 90 };
    EXPECT_EQ( decode_sample_rate( short_value ), std::unexpected( std::errc::message_size ) );
}

} // namespace
```
