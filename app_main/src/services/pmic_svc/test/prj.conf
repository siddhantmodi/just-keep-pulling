## CMakeLists.txt
```
# SPDX-License-Identifier: Apache-2.0

cmake_minimum_required(VERSION 3.20.0)

find_package(Zephyr REQUIRED HINTS $ENV{ZEPHYR_BASE})
project(test_pmic_svc)

target_compile_options(app PRIVATE -Werror)

# The Pmic class with a mocked charger and power switch (lib/hal's mocks).
target_include_directories(app PRIVATE ../inc ../src)

target_sources(app PRIVATE
    ../src/pmic.cpp
    src/test_pmic.cpp
)
```

## prj.conf
```kconfig
# GoogleTest unit test. lib/gtest builds gtest/gmock and provides main();
# Twister runs it with the gtest harness.
CONFIG_GTEST=y

# Same C++ settings as production so test codegen matches.
CONFIG_CPP=y
CONFIG_STD_CPP23=y
CONFIG_REQUIRES_FULL_LIBCPP=y
CONFIG_CPP_EXCEPTIONS=n
CONFIG_CPP_RTTI=n

CONFIG_ASSERT=y
CONFIG_BOOT_BANNER=n
CONFIG_LOG=y

# gtest/gmock need more stack and heap than Zephyr's defaults.
CONFIG_MAIN_STACK_SIZE=32768
CONFIG_HEAP_MEM_POOL_SIZE=131072
```

## src/test_pmic.cpp
```c
/**
 * @file test_pmic.cpp
 * @brief Unit tests of pmic_svc::Pmic against a mocked charger and power switch.
 *
 * SPDX-License-Identifier: Apache-2.0
 */

#include "pmic.hpp"

#include <expected>
#include <gmock/gmock.h>
#include <gtest/gtest.h>
#include <hal/mocks/mock_battery_charger.hpp>
#include <hal/mocks/mock_power_off.hpp>
#include <system_error>

namespace
{

using testing::Return;

class PmicTest : public testing::Test
{
protected:
    testing::StrictMock<hal::mocks::MockBatteryCharger> charger_;
    testing::StrictMock<hal::mocks::MockPowerOff> power_off_;
    pmic_svc::Pmic pmic_{ charger_, power_off_ };
};

TEST_F( PmicTest, InitChecksTheChargerAndThePowerSwitch )
{
    EXPECT_CALL( charger_, init() ).WillOnce( Return( fw::Result<>{} ) );
    EXPECT_CALL( power_off_, init() ).WillOnce( Return( fw::Result<>{} ) );
    EXPECT_TRUE( pmic_.init() );
}

TEST_F( PmicTest, InitFailsWhenTheChargerIsNotReady )
{
    EXPECT_CALL( charger_, init() ).WillOnce( Return( std::unexpected( std::errc::no_such_device ) ) );
    EXPECT_EQ( pmic_.init(), std::unexpected( std::errc::no_such_device ) );
}

TEST_F( PmicTest, InitFailsWhenThePowerSwitchIsNotReady )
{
    EXPECT_CALL( charger_, init() ).WillOnce( Return( fw::Result<>{} ) );
    EXPECT_CALL( power_off_, init() ).WillOnce( Return( std::unexpected( std::errc::no_such_device ) ) );
    EXPECT_EQ( pmic_.init(), std::unexpected( std::errc::no_such_device ) );
}

TEST_F( PmicTest, ReadsTheBattery )
{
    hal::BatteryStatus const status{ .millivolts = 3812, .charge = hal::ChargeState::constant_current, .external_power = true };
    EXPECT_CALL( charger_, read() ).WillOnce( Return( status ) );

    auto read = pmic_.read_battery();
    ASSERT_TRUE( read );
    EXPECT_EQ( read->millivolts, 3812U );
    EXPECT_TRUE( read->charging() );
    EXPECT_TRUE( read->external_power );
}

TEST_F( PmicTest, ReportsAFailedRead )
{
    EXPECT_CALL( charger_, read() ).WillOnce( Return( std::unexpected( std::errc::io_error ) ) );
    EXPECT_EQ( pmic_.read_battery().error(), std::errc::io_error );
}

TEST_F( PmicTest, ShipModePowersOff )
{
    EXPECT_CALL( power_off_, power_off() ).WillOnce( Return( fw::Result<>{} ) );
    EXPECT_TRUE( pmic_.ship_mode() );
}

TEST_F( PmicTest, ShipModeReportsAFailure )
{
    EXPECT_CALL( power_off_, power_off() ).WillOnce( Return( std::unexpected( std::errc::io_error ) ) );
    EXPECT_EQ( pmic_.ship_mode(), std::unexpected( std::errc::io_error ) );
}

} // namespace
```
