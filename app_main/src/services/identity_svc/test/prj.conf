## CMakeLists.txt
```
# SPDX-License-Identifier: Apache-2.0

cmake_minimum_required(VERSION 3.20.0)

find_package(Zephyr REQUIRED HINTS $ENV{ZEPHYR_BASE})
project(test_identity_svc)

target_compile_options(app PRIVATE -Werror)

# The Identity class with real settings (native_sim's flash simulator) and the
# real random number generator; the production instance is not built.
target_include_directories(app PRIVATE ../inc ../src)

target_sources(app PRIVATE
    ../src/identity.cpp
    src/test_identity.cpp
)
```

## prj.conf
```kconfig
# GoogleTest unit test. lib/gtest builds gtest/gmock and provides main();
# Twister runs it with the gtest harness.
CONFIG_GTEST=y

# Same C++ settings as production so test codegen matches.
CONFIG_CPP=y
CONFIG_STD_CPP23=y
CONFIG_REQUIRES_FULL_LIBCPP=y
CONFIG_CPP_EXCEPTIONS=n
CONFIG_CPP_RTTI=n

CONFIG_ASSERT=y
CONFIG_BOOT_BANNER=n
CONFIG_LOG=y

# The ID is saved for real, on native_sim's simulated flash.
CONFIG_FLASH=y
CONFIG_FLASH_MAP=y
CONFIG_ZMS=y
CONFIG_SETTINGS=y
CONFIG_SETTINGS_ZMS=y

# The ID comes from the random number generator, seeded by the entropy driver.
CONFIG_ENTROPY_GENERATOR=y

# gtest/gmock need more stack and heap than Zephyr's defaults.
CONFIG_MAIN_STACK_SIZE=32768
CONFIG_HEAP_MEM_POOL_SIZE=131072
```

## src/test_identity.cpp
```c
/**
 * @file test_identity.cpp
 * @brief Unit tests for identity_svc: the ID's text form, generation on first boot and overwriting.
 *
 * SPDX-License-Identifier: Apache-2.0
 */

#include "identity.hpp"

#include <fw/settings.hpp>
#include <gtest/gtest.h>
#include <string_view>
#include <system_error>

using identity_svc::DeviceId;

namespace
{

TEST( DeviceIdTextTest, ParsesTwelveHexDigitsInEitherCase )
{
    auto id = identity_svc::parse_device_id( "7e4E17010a3C" );

    ASSERT_TRUE( id );
    EXPECT_EQ( *id, ( DeviceId{ 0x7E, 0x4E, 0x17, 0x01, 0x0A, 0x3C } ) );
}

TEST( DeviceIdTextTest, RejectsWrongLengthOrNonHex )
{
    for( std::string_view const text : { "", "7E4E17010A3", "7E4E17010A3C0", "7E4E17010A3G", "7E:4E:17:01" } ) {
        EXPECT_EQ( identity_svc::parse_device_id( text ).error(), std::errc::invalid_argument ) << text;
    }
}

TEST( DeviceIdTextTest, FormatsUpperCaseHex )
{
    EXPECT_STREQ( identity_svc::format_device_id( DeviceId{ 0x7E, 0x4E, 0x17, 0x01, 0x0A, 0x3C } ).data(), "7E4E17010A3C" );
}

class IdentityTest : public ::testing::Test
{
protected:
    void SetUp() override
    {
        ASSERT_TRUE( fw::settings::init() );
        (void)fw::settings::erase( identity_svc::id_key );
    }

    void TearDown() override
    {
        (void)fw::settings::erase( identity_svc::id_key );
    }
};

TEST_F( IdentityTest, FirstBootGeneratesAndSavesAnId )
{
    identity_svc::Identity identity;

    ASSERT_TRUE( identity.init() );

    EXPECT_NE( identity.id(), DeviceId{} );
    auto saved = fw::settings::load<DeviceId>( identity_svc::id_key );
    ASSERT_TRUE( saved );
    EXPECT_EQ( *saved, identity.id() );
}

TEST_F( IdentityTest, LaterBootsKeepTheSameId )
{
    identity_svc::Identity first_boot;
    ASSERT_TRUE( first_boot.init() );

    identity_svc::Identity second_boot;
    ASSERT_TRUE( second_boot.init() );

    EXPECT_EQ( second_boot.id(), first_boot.id() );
}

TEST_F( IdentityTest, BlankSavedIdIsReplaced )
{
    ASSERT_TRUE( fw::settings::save( identity_svc::id_key, DeviceId{} ) );
    identity_svc::Identity identity;

    ASSERT_TRUE( identity.init() );

    EXPECT_NE( identity.id(), DeviceId{} );
}

TEST_F( IdentityTest, SetIdSavesItForTheNextBoot )
{
    identity_svc::Identity identity;
    ASSERT_TRUE( identity.init() );
    DeviceId const chosen{ 0x12, 0x34, 0x56, 0x78, 0x9A, 0xBC };

    DeviceId const booted = identity.id();

    ASSERT_TRUE( identity.set_id( chosen ) );

    EXPECT_EQ( identity.id(), booted );
    identity_svc::Identity next_boot;
    ASSERT_TRUE( next_boot.init() );
    EXPECT_EQ( next_boot.id(), chosen );
}

TEST_F( IdentityTest, SetIdRejectsBlankIds )
{
    identity_svc::Identity identity;
    ASSERT_TRUE( identity.init() );
    DeviceId const before = identity.id();

    EXPECT_EQ( identity.set_id( DeviceId{} ).error(), std::errc::invalid_argument );
    EXPECT_EQ( identity.set_id( DeviceId{ 0xFF, 0xFF, 0xFF, 0xFF, 0xFF, 0xFF } ).error(), std::errc::invalid_argument );
    EXPECT_EQ( identity.id(), before );
}

} // namespace
```
