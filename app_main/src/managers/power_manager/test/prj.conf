## CMakeLists.txt
```
# SPDX-License-Identifier: Apache-2.0

cmake_minimum_required(VERSION 3.20.0)

find_package(Zephyr REQUIRED HINTS $ENV{ZEPHYR_BASE})
project(test_power_manager)

target_compile_options(app PRIVATE -Werror)

# The Power, Activity, Indicator and Gauge classes with a mocked PMIC, IMU, LED, client
# and fuel gauge (each component's or the HAL's own mock), the app's real zbus channels
# and settings, and the real progressor encoding.
target_include_directories(app PRIVATE
    ../inc
    ../src
    ../../../channels/inc
    ../../../modules/progressor/inc
    ../../../services/ble_svc/inc
    ../../../services/ble_svc/mocks
    ../../../services/led_svc/inc
    ../../../services/led_svc/mocks
    ../../../services/motion_svc/inc
    ../../../services/motion_svc/mocks
    ../../../services/pmic_svc/inc
    ../../../services/pmic_svc/mocks
)

target_sources(app PRIVATE
    ../../../channels/src/channels.cpp
    ../../../modules/progressor/src/progressor.cpp
    ../src/activity.cpp
    ../src/gauge.cpp
    ../src/indicator.cpp
    ../src/power.cpp
    src/test_activity.cpp
    src/test_curve_gauge.cpp
    src/test_gauge.cpp
    src/test_indicator.cpp
    src/test_power.cpp
)
```

## prj.conf
```kconfig
# GoogleTest unit test. lib/gtest builds gtest/gmock and provides main();
# Twister runs it with the gtest harness.
CONFIG_GTEST=y

# Same C++ settings as production so test codegen matches.
CONFIG_CPP=y
CONFIG_STD_CPP23=y
CONFIG_REQUIRES_FULL_LIBCPP=y
CONFIG_CPP_EXCEPTIONS=n
CONFIG_CPP_RTTI=n

CONFIG_ASSERT=y
CONFIG_BOOT_BANNER=n
CONFIG_LOG=y

# The manager publishes to the app's real zbus channels.
CONFIG_ZBUS=y

# Real settings for the fuel gauge's state, on native_sim's flash simulator.
CONFIG_FLASH=y
CONFIG_FLASH_MAP=y
CONFIG_ZMS=y
CONFIG_SETTINGS=y
CONFIG_SETTINGS_ZMS=y

# gtest/gmock need more stack and heap than Zephyr's defaults.
CONFIG_MAIN_STACK_SIZE=32768
CONFIG_HEAP_MEM_POOL_SIZE=131072
```

## src/test_activity.cpp
```c
/**
 * @file test_activity.cpp
 * @brief Unit tests of power_manager::Activity against a mocked IMU, client and fuel gauge.
 *
 * SPDX-License-Identifier: Apache-2.0
 */

#include "activity.hpp"
#include "mock_client.hpp"
#include "mock_led.hpp"
#include "mock_motion.hpp"

#include <chrono>
#include <expected>
#include <fw/settings.hpp>
#include <gmock/gmock.h>
#include <gtest/gtest.h>
#include <hal/mocks/mock_fuel_gauge.hpp>
#include <system_error>

namespace
{

using namespace std::chrono_literals;
using power_manager::activity_check_interval;
using progressor::Opcode;
using testing::_;
using testing::NiceMock;
using testing::Return;
using testing::StrictMock;

constexpr power_manager::IdleTimeouts timeouts{ .disconnected = 240s, .connected = 600s };

class ActivityTest : public testing::Test
{
protected:
    ActivityTest()
    {
        ON_CALL( motion_, moved() ).WillByDefault( Return( false ) );
        EXPECT_CALL( motion_, moved() ).Times( testing::AnyNumber() );
    }

    void SetUp() override
    {
        ASSERT_TRUE( fw::settings::init() );
    }

    /** @brief Run the checks that fit in @p duration, all expected to succeed. */
    void idle_for( std::chrono::seconds duration )
    {
        for( auto elapsed = 0s; elapsed < duration; elapsed += activity_check_interval ) {
            ASSERT_TRUE( activity_.check() );
        }
    }

    StrictMock<motion_svc::MockMotion> motion_;
    StrictMock<ble_svc::MockClient> client_;
    NiceMock<led_svc::MockLed> led_;
    power_manager::Indicator indicator_{ led_ };
    NiceMock<hal::mocks::MockFuelGauge> fuel_;
    power_manager::Gauge gauge_{ fuel_ };
    power_manager::Activity activity_{ motion_, client_, indicator_, gauge_, timeouts };
};

TEST_F( ActivityTest, CountsIdleTime )
{
    idle_for( 60s );
    EXPECT_EQ( activity_.idle(), 60s );
}

TEST_F( ActivityTest, SleepsAfterTheTimeoutWithoutAClient )
{
    idle_for( 230s );
    EXPECT_CALL( motion_, sleep_until_moved() ).WillOnce( Return( fw::Result<>{} ) );
    EXPECT_TRUE( activity_.check() );
}

TEST_F( ActivityTest, SavesTheGaugeBeforeSleeping )
{
    ON_CALL( fuel_, state_size() ).WillByDefault( Return( 4 ) );
    ASSERT_TRUE( gauge_.update( {}, 0s ) ); // started, so there is a state to save
    idle_for( 230s );
    testing::InSequence const in_order;
    EXPECT_CALL( fuel_, save_state( _ ) ).WillOnce( Return( fw::Result<>{} ) );
    EXPECT_CALL( motion_, sleep_until_moved() ).WillOnce( Return( fw::Result<>{} ) );
    EXPECT_TRUE( activity_.check() );
}

TEST_F( ActivityTest, TurnsTheLedOffToSleepAndBackOnIfItCannot )
{
    idle_for( 230s );
    ON_CALL( led_, color() ).WillByDefault( Return( led_svc::Color::green ) ); // so both writes are needed
    testing::InSequence const in_order;
    EXPECT_CALL( led_, show( led_svc::Color::off ) ).WillOnce( Return( fw::Result<>{} ) );
    EXPECT_CALL( motion_, sleep_until_moved() ).WillOnce( Return( std::unexpected( std::errc::not_supported ) ) );
    EXPECT_CALL( led_, show( led_svc::Color::blue ) ).WillOnce( Return( fw::Result<>{} ) );

    EXPECT_FALSE( activity_.check() );
}

TEST_F( ActivityTest, MotionKeepsItAwake )
{
    idle_for( 200s );
    EXPECT_CALL( motion_, moved() ).WillOnce( Return( true ) );
    ASSERT_TRUE( activity_.check() );
    EXPECT_EQ( activity_.idle(), 0s );
}

TEST_F( ActivityTest, CommandsKeepItAwake )
{
    idle_for( 200s );
    activity_.on_command( Opcode::tare );
    EXPECT_EQ( activity_.idle(), 0s );
}

TEST_F( ActivityTest, ConfigurationKeepsItAwake )
{
    idle_for( 200s );
    activity_.on_configuration();
    EXPECT_EQ( activity_.idle(), 0s );
}

TEST_F( ActivityTest, BatteryPollsDoNotKeepItAwake )
{
    idle_for( 200s );
    activity_.on_command( Opcode::sample_battery );
    EXPECT_EQ( activity_.idle(), 200s );
}

TEST_F( ActivityTest, AMeasurementStartingOrStoppingKeepsItAwake )
{
    idle_for( 200s );
    activity_.on_measurement();
    EXPECT_EQ( activity_.idle(), 0s );
}

TEST_F( ActivityTest, PullsKeepItAwake )
{
    activity_.on_client_connection( true );
    activity_.on_measurement();
    for( int minute = 0; minute < 60; ++minute ) {
        idle_for( 60s );
        activity_.on_pull();
    }
    EXPECT_EQ( activity_.idle(), 0s ); // an hour of pulls: no disconnect (StrictMock fails on any call)
}

TEST_F( ActivityTest, AMeasurementNobodyPullsOnIdlesLikeAConnection )
{
    activity_.on_client_connection( true );
    activity_.on_measurement();
    idle_for( 590s );
    EXPECT_CALL( client_, disconnect() ).WillOnce( Return( fw::Result<>{} ) );

    idle_for( 10s );
}

TEST_F( ActivityTest, WaitsLongerWithAClient )
{
    activity_.on_client_connection( true );
    idle_for( 590s ); // past the 240 s without a client
    EXPECT_EQ( activity_.idle(), 590s );
}

TEST_F( ActivityTest, DisconnectsTheClientThenSleeps )
{
    activity_.on_client_connection( true );
    idle_for( 590s );

    EXPECT_CALL( client_, disconnect() ).WillOnce( Return( fw::Result<>{} ) );
    ASSERT_TRUE( activity_.check() );

    activity_.on_client_connection( false ); // the disconnection asked for
    EXPECT_CALL( motion_, sleep_until_moved() ).WillOnce( Return( fw::Result<>{} ) );
    EXPECT_TRUE( activity_.check() );
}

TEST_F( ActivityTest, AReconnectionCancelsTheSleep )
{
    activity_.on_client_connection( true );
    idle_for( 590s );
    EXPECT_CALL( client_, disconnect() ).WillOnce( Return( fw::Result<>{} ) );
    ASSERT_TRUE( activity_.check() );
    activity_.on_client_connection( false );

    activity_.on_client_connection( true );
    ASSERT_TRUE( activity_.check() ); // no sleep
    EXPECT_EQ( activity_.idle(), activity_check_interval );
}

TEST_F( ActivityTest, MotionWhileDisconnectingCancelsTheSleep )
{
    activity_.on_client_connection( true );
    idle_for( 590s );
    EXPECT_CALL( client_, disconnect() ).WillOnce( Return( fw::Result<>{} ) );
    ASSERT_TRUE( activity_.check() );

    EXPECT_CALL( motion_, moved() ).WillOnce( Return( true ) );
    ASSERT_TRUE( activity_.check() ); // no sleep
    EXPECT_EQ( activity_.idle(), 0s );
}

TEST_F( ActivityTest, AFailedSleepStartsCountingAgain )
{
    idle_for( 230s );
    EXPECT_CALL( motion_, sleep_until_moved() ).WillOnce( Return( std::unexpected( std::errc::not_supported ) ) );

    EXPECT_EQ( activity_.check(), std::unexpected( std::errc::not_supported ) );
    EXPECT_EQ( activity_.idle(), 0s );
}

} // namespace
```

## src/test_curve_gauge.cpp
```c
/**
 * @file test_curve_gauge.cpp
 * @brief Unit tests of power_manager::CurveGauge, the voltage-only stand-in for the fuel gauge.
 *
 * SPDX-License-Identifier: Apache-2.0
 */

#include "curve_gauge.hpp"

#include <chrono>
#include <gtest/gtest.h>

namespace
{

using power_manager::curve_percent;

TEST( CurvePercent, EmptyAtThePowerOffVoltageAndBelow )
{
    EXPECT_EQ( curve_percent( 3300 ), 0 );
    EXPECT_EQ( curve_percent( 0 ), 0 );
}

TEST( CurvePercent, FullAtTheChargeVoltageAndAbove )
{
    EXPECT_EQ( curve_percent( 4200 ), 100 );
    EXPECT_EQ( curve_percent( 4350 ), 100 );
}

TEST( CurvePercent, FollowsTheCurve )
{
    EXPECT_EQ( curve_percent( 3750 ), 25 );
    EXPECT_EQ( curve_percent( 3900 ), 65 );
    EXPECT_EQ( curve_percent( 3950 ), 72 ); // halfway from 65 to 80
}

TEST( CurvePercent, NeverDecreasesWithVoltage )
{
    unsigned previous = 0;
    for( std::uint32_t mv = 3000; mv <= 4400; mv += 10 ) {
        unsigned const level = curve_percent( mv );
        EXPECT_GE( level, previous ) << mv << " mV";
        previous = level;
    }
}

static_assert( curve_percent( 4100 ) == 92, "usable at compile time" );

TEST( CurveGauge, ReportsTheCurveAndKeepsNoState )
{
    power_manager::CurveGauge gauge;
    EXPECT_TRUE( gauge.init( { .millivolts = 3750 }, {} ) );
    EXPECT_EQ( gauge.update( { .millivolts = 3750 }, std::chrono::seconds{ 5 } ), 25.0F );
    EXPECT_EQ( gauge.state_size(), 0U );
}

} // namespace
```

## src/test_gauge.cpp
```c
/**
 * @file test_gauge.cpp
 * @brief Unit tests of power_manager::Gauge against a mocked fuel gauge, with real settings.
 *
 * SPDX-License-Identifier: Apache-2.0
 */

#include "gauge.hpp"

#include <algorithm>
#include <array>
#include <chrono>
#include <cstddef>
#include <expected>
#include <fw/settings.hpp>
#include <gmock/gmock.h>
#include <gtest/gtest.h>
#include <hal/mocks/mock_fuel_gauge.hpp>
#include <span>
#include <system_error>

namespace
{

using namespace std::chrono_literals;
using power_manager::gauge_state_key;
using testing::_;
using testing::NiceMock;
using testing::Return;

constexpr hal::BatteryStatus reading{ .millivolts = 3800 };
constexpr std::array<std::byte, 4> saved{ std::byte{ 1 }, std::byte{ 2 }, std::byte{ 3 }, std::byte{ 4 } };

auto is_empty()
{
    return testing::Truly( []( std::span<const std::byte> state ) { return state.empty(); } );
}

auto holds_saved()
{
    return testing::Truly( []( std::span<const std::byte> state ) { return std::ranges::equal( state, saved ); } );
}

class GaugeTest : public testing::Test
{
protected:
    void SetUp() override
    {
        ASSERT_TRUE( fw::settings::init() );
        (void)fw::settings::erase( gauge_state_key );
        ON_CALL( fuel_, state_size() ).WillByDefault( Return( saved.size() ) );
        ON_CALL( fuel_, update( _, _ ) ).WillByDefault( Return( 50.0F ) );
        ON_CALL( fuel_, save_state( _ ) )
            .WillByDefault(
                []( std::span<std::byte> out )
                {
                    std::ranges::copy( saved, out.begin() );
                    return fw::Result<>{};
                } );
    }

    NiceMock<hal::mocks::MockFuelGauge> fuel_;
    power_manager::Gauge gauge_{ fuel_ };
};

TEST_F( GaugeTest, StartsFromTheFirstReadingWithoutASavedState )
{
    EXPECT_CALL( fuel_, init( _, is_empty() ) );
    EXPECT_CALL( fuel_, update( _, 0ms ) ).WillOnce( Return( 42.4F ) );

    EXPECT_EQ( gauge_.update( reading, 5s ), 42 );
}

TEST_F( GaugeTest, ResumesFromTheSavedState )
{
    ASSERT_TRUE( fw::settings::save_bytes( gauge_state_key, saved ) );
    EXPECT_CALL( fuel_, init( _, holds_saved() ) );

    ASSERT_TRUE( gauge_.update( reading, 0s ) );
}

TEST_F( GaugeTest, StartsFreshWhenTheSavedStateIsUnusable )
{
    ASSERT_TRUE( fw::settings::save_bytes( gauge_state_key, saved ) );
    testing::InSequence const in_order;
    EXPECT_CALL( fuel_, init( _, holds_saved() ) ).WillOnce( Return( std::unexpected( std::errc::invalid_argument ) ) );
    EXPECT_CALL( fuel_, init( _, is_empty() ) );

    ASSERT_TRUE( gauge_.update( reading, 0s ) );
}

TEST_F( GaugeTest, IgnoresASavedStateOfAnotherSize )
{
    ASSERT_TRUE( fw::settings::save_bytes( gauge_state_key, std::span{ saved }.first( 3 ) ) );
    EXPECT_CALL( fuel_, init( _, is_empty() ) );

    ASSERT_TRUE( gauge_.update( reading, 0s ) );
}

TEST_F( GaugeTest, FailsWhenTheGaugeCannotStart )
{
    EXPECT_CALL( fuel_, init( _, _ ) ).WillOnce( Return( std::unexpected( std::errc::io_error ) ) );
    EXPECT_CALL( fuel_, update( _, _ ) ).Times( 0 );

    EXPECT_EQ( gauge_.update( reading, 0s ), std::unexpected( std::errc::io_error ) );
}

TEST_F( GaugeTest, PassesTheElapsedTimeAfterTheFirstReading )
{
    testing::InSequence const in_order;
    EXPECT_CALL( fuel_, update( _, 0ms ) );
    EXPECT_CALL( fuel_, update( _, 5000ms ) );

    ASSERT_TRUE( gauge_.update( reading, 7s ) );
    ASSERT_TRUE( gauge_.update( reading, 5s ) );
}

TEST_F( GaugeTest, RoundsAndClampsTheLevel )
{
    EXPECT_CALL( fuel_, update( _, _ ) ).WillOnce( Return( 49.5F ) ).WillOnce( Return( 100.6F ) ).WillOnce( Return( -2.0F ) );

    EXPECT_EQ( gauge_.update( reading, 0s ), 50 );
    EXPECT_EQ( gauge_.update( reading, 5s ), 100 );
    EXPECT_EQ( gauge_.update( reading, 5s ), 0 );
}

TEST_F( GaugeTest, SavesTheStateEveryInterval )
{
    ASSERT_TRUE( gauge_.update( reading, 0s ) );
    EXPECT_CALL( fuel_, save_state( _ ) ).Times( 0 );
    for( auto elapsed = 5s; elapsed < power_manager::gauge_save_interval; elapsed += 5s ) {
        ASSERT_TRUE( gauge_.update( reading, 5s ) );
    }
    testing::Mock::VerifyAndClearExpectations( &fuel_ );

    EXPECT_CALL( fuel_, save_state( _ ) );
    ASSERT_TRUE( gauge_.update( reading, 5s ) );

    std::array<std::byte, saved.size()> stored{};
    ASSERT_TRUE( fw::settings::load_bytes( gauge_state_key, stored ) );
    EXPECT_EQ( stored, saved );
}

TEST_F( GaugeTest, SaveWritesTheStateToSettings )
{
    ASSERT_TRUE( gauge_.update( reading, 0s ) );
    ASSERT_TRUE( gauge_.save() );

    std::array<std::byte, saved.size()> stored{};
    ASSERT_TRUE( fw::settings::load_bytes( gauge_state_key, stored ) );
    EXPECT_EQ( stored, saved );
}

TEST_F( GaugeTest, NothingToSaveBeforeTheFirstReadingOrWithoutState )
{
    EXPECT_CALL( fuel_, save_state( _ ) ).Times( 0 );
    EXPECT_TRUE( gauge_.save() );

    ON_CALL( fuel_, state_size() ).WillByDefault( Return( 0 ) );
    ASSERT_TRUE( gauge_.update( reading, 0s ) );
    EXPECT_TRUE( gauge_.save() );
}

} // namespace
```

## src/test_indicator.cpp
```c
/**
 * @file test_indicator.cpp
 * @brief Unit tests of power_manager::Indicator against a fake LED that remembers its color.
 *
 * SPDX-License-Identifier: Apache-2.0
 */

#include "indicator.hpp"
#include "mock_led.hpp"

#include <gmock/gmock.h>
#include <gtest/gtest.h>
#include <vector>

namespace
{

using led_svc::Color;
using power_manager::blink_steps;
using testing::_;
using testing::NiceMock;

class IndicatorTest : public testing::Test
{
protected:
    IndicatorTest()
    {
        ON_CALL( led_, color() ).WillByDefault( [this] { return color_; } );
        ON_CALL( led_, show( _ ) )
            .WillByDefault(
                [this]( Color color )
                {
                    color_ = color;
                    shown_.push_back( color );
                    return fw::Result<>{};
                } );
    }

    /** @brief The colors over @p steps blink steps. */
    std::vector<Color> blink( unsigned steps )
    {
        std::vector<Color> colors;
        for( unsigned i = 0; i < steps; ++i ) {
            EXPECT_TRUE( indicator_.on_blink_step() );
            colors.push_back( color_ );
        }
        return colors;
    }

    NiceMock<led_svc::MockLed> led_;
    power_manager::Indicator indicator_{ led_ };
    Color color_{ Color::off };
    std::vector<Color> shown_;
};

TEST_F( IndicatorTest, BlueWithoutAClient )
{
    ASSERT_TRUE( indicator_.start() );
    EXPECT_EQ( color_, Color::blue );
    EXPECT_FALSE( indicator_.blinking() );
}

TEST_F( IndicatorTest, GreenWithAClient )
{
    ASSERT_TRUE( indicator_.on_client_connection( true ) );
    EXPECT_EQ( color_, Color::green );

    ASSERT_TRUE( indicator_.on_client_connection( false ) );
    EXPECT_EQ( color_, Color::blue );
}

TEST_F( IndicatorTest, BlinksRedOnALowBattery )
{
    ASSERT_TRUE( indicator_.on_client_connection( true ) );
    ASSERT_TRUE( indicator_.on_battery( 10 ) );

    EXPECT_TRUE( indicator_.blinking() );
    EXPECT_EQ( color_, Color::red ); // starts on
    EXPECT_EQ( blink( blink_steps ), ( std::vector{ Color::off, Color::off, Color::off, Color::red } ) );
}

TEST_F( IndicatorTest, StopsBlinkingWhenTheBatteryRecovers )
{
    ASSERT_TRUE( indicator_.on_battery( 5 ) );
    ASSERT_TRUE( indicator_.on_battery( 50 ) );

    EXPECT_FALSE( indicator_.blinking() );
    EXPECT_EQ( color_, Color::blue );
}

TEST_F( IndicatorTest, OffWhileSleeping )
{
    ASSERT_TRUE( indicator_.on_battery( 5 ) );
    ASSERT_TRUE( indicator_.on_sleep( true ) );

    EXPECT_EQ( color_, Color::off );
    EXPECT_FALSE( indicator_.blinking() );

    ASSERT_TRUE( indicator_.on_sleep( false ) );
    EXPECT_EQ( color_, Color::red );
}

TEST_F( IndicatorTest, OnlyWritesTheLedWhenTheColorChanges )
{
    ASSERT_TRUE( indicator_.start() );
    ASSERT_TRUE( indicator_.on_battery( 80 ) );
    ASSERT_TRUE( indicator_.on_battery( 60 ) );

    EXPECT_EQ( shown_, ( std::vector{ Color::blue } ) );
}

} // namespace
```

## src/test_power.cpp
```c
/**
 * @file test_power.cpp
 * @brief Unit tests of power_manager::Power against a mocked PMIC, client and fuel gauge, with real zbus channels and settings.
 *
 * SPDX-License-Identifier: Apache-2.0
 */

#include "channels.hpp"
#include "mock_client.hpp"
#include "mock_pmic.hpp"
#include "power.hpp"

#include <chrono>
#include <cstdint>
#include <expected>
#include <fw/settings.hpp>
#include <gmock/gmock.h>
#include <gtest/gtest.h>
#include <hal/mocks/mock_fuel_gauge.hpp>
#include <span>
#include <system_error>
#include <vector>

namespace
{

using namespace std::chrono_literals;
using testing::_;
using testing::NiceMock;
using testing::Return;
using testing::StrictMock;

constexpr hal::BatteryStatus healthy{ .millivolts = 3900, .external_power = false };
constexpr hal::BatteryStatus low{ .millivolts = 3300, .external_power = false };

class PowerTest : public testing::Test
{
protected:
    PowerTest()
    {
        ON_CALL( fuel_, update( _, _ ) ).WillByDefault( Return( 50.0F ) );
        ON_CALL( client_, send_progressor( _ ) )
            .WillByDefault(
                [this]( std::span<const std::uint8_t> bytes )
                {
                    sent_.emplace_back( bytes.begin(), bytes.end() );
                    return fw::Result<>{};
                } );
    }

    void battery_reads( hal::BatteryStatus status )
    {
        ON_CALL( pmic_, read_battery() ).WillByDefault( Return( status ) );
    }

    void SetUp() override
    {
        ASSERT_TRUE( fw::settings::init() );
    }

    StrictMock<pmic_svc::MockPmic> pmic_;
    NiceMock<ble_svc::MockClient> client_;
    NiceMock<hal::mocks::MockFuelGauge> fuel_;
    power_manager::Gauge gauge_{ fuel_ };
    power_manager::Power power_{ pmic_, client_, gauge_ };
    std::vector<std::vector<std::uint8_t>> sent_;
};

TEST( IsLow, AtOrBelowTheThresholdOnBatteryAlone )
{
    EXPECT_TRUE( power_manager::is_low( { .millivolts = 3300, .external_power = false } ) );
    EXPECT_TRUE( power_manager::is_low( { .millivolts = 3000, .external_power = false } ) );
    EXPECT_FALSE( power_manager::is_low( { .millivolts = 3301, .external_power = false } ) );
}

TEST( IsLow, NotWhileChargingOrOnUsb )
{
    EXPECT_FALSE( power_manager::is_low( { .millivolts = 3200, .charge = hal::ChargeState::constant_current, .external_power = true } ) );
    EXPECT_FALSE( power_manager::is_low( { .millivolts = 3200, .external_power = true } ) );
    EXPECT_FALSE( power_manager::is_low( { .millivolts = 3200, .charge = hal::ChargeState::constant_current, .external_power = false } ) );
}

TEST_F( PowerTest, PublishesEachReading )
{
    EXPECT_CALL( pmic_, read_battery() ).WillOnce( Return( healthy ) );

    ASSERT_TRUE( power_.check() );

    auto published = channels::battery.read( K_NO_WAIT );
    ASSERT_TRUE( published );
    EXPECT_EQ( published->status.millivolts, 3900U );
    EXPECT_EQ( published->percent, 50 );
    EXPECT_EQ( power_.next_check(), power_manager::check_interval );
}

TEST_F( PowerTest, GivesTheGaugeTheTimeSinceTheLastReading )
{
    EXPECT_CALL( pmic_, read_battery() )
        .WillOnce( Return( healthy ) )
        .WillOnce( Return( healthy ) )
        .WillOnce( Return( std::unexpected( std::errc::io_error ) ) )
        .WillOnce( Return( healthy ) );
    testing::InSequence const in_order;
    EXPECT_CALL( fuel_, update( _, 0ms ) );
    EXPECT_CALL( fuel_, update( _, std::chrono::milliseconds{ power_manager::check_interval } ) );
    EXPECT_CALL( fuel_, update( _, 2 * power_manager::check_interval ) ); // across the failed read

    ASSERT_TRUE( power_.check() );
    ASSERT_TRUE( power_.check() );
    ASSERT_FALSE( power_.check() );
    ASSERT_TRUE( power_.check() );
}

TEST_F( PowerTest, KeepsTheLastLevelWhenTheGaugeFails )
{
    battery_reads( healthy );
    EXPECT_CALL( pmic_, read_battery() ).Times( 2 );
    EXPECT_CALL( fuel_, update( _, _ ) ).WillOnce( Return( 72.0F ) ).WillOnce( Return( std::unexpected( std::errc::io_error ) ) );

    ASSERT_TRUE( power_.check() );
    ASSERT_TRUE( power_.check() );

    auto published = channels::battery.read( K_NO_WAIT );
    ASSERT_TRUE( published );
    EXPECT_EQ( published->percent, 72 );
}

TEST_F( PowerTest, AFailedReadIsRetriedAtTheNextInterval )
{
    EXPECT_CALL( pmic_, read_battery() ).WillOnce( Return( std::unexpected( std::errc::io_error ) ) );

    EXPECT_EQ( power_.check(), std::unexpected( std::errc::io_error ) );
    EXPECT_EQ( power_.next_check(), power_manager::check_interval );
}

TEST_F( PowerTest, ALowReadingIsConfirmedSoon )
{
    EXPECT_CALL( pmic_, read_battery() ).WillOnce( Return( low ) );

    ASSERT_TRUE( power_.check() );

    EXPECT_EQ( power_.next_check(), power_manager::confirm_delay );
    EXPECT_TRUE( sent_.empty() );
}

TEST_F( PowerTest, ARecoveredReadingCancelsTheConfirmation )
{
    EXPECT_CALL( pmic_, read_battery() ).WillOnce( Return( low ) ).WillOnce( Return( healthy ) ).WillOnce( Return( healthy ) );

    ASSERT_TRUE( power_.check() );
    ASSERT_TRUE( power_.check() );
    EXPECT_EQ( power_.next_check(), power_manager::check_interval );
    EXPECT_TRUE( sent_.empty() );

    ASSERT_TRUE( power_.check() ); // no ship mode: StrictMock would fail
}

TEST_F( PowerTest, AConfirmedLowBatteryWarnsTheClientThenEntersShipMode )
{
    battery_reads( low );
    EXPECT_CALL( pmic_, read_battery() ).Times( 2 );

    ASSERT_TRUE( power_.check() );
    ASSERT_TRUE( power_.check() );

    ASSERT_EQ( sent_.size(), 1U );
    EXPECT_EQ( sent_[0], ( std::vector<std::uint8_t>{ 0x04, 0x00 } ) ); // code, zero length
    EXPECT_EQ( power_.next_check(), power_manager::warning_delay );

    EXPECT_CALL( pmic_, ship_mode() ).WillOnce( Return( fw::Result<>{} ) );
    EXPECT_TRUE( power_.check() );
}

TEST_F( PowerTest, SavesTheGaugeBeforeShipMode )
{
    battery_reads( low );
    EXPECT_CALL( pmic_, read_battery() ).Times( 2 );
    ON_CALL( fuel_, state_size() ).WillByDefault( Return( 4 ) );
    ASSERT_TRUE( power_.check() );
    ASSERT_TRUE( power_.check() );

    testing::InSequence const in_order;
    EXPECT_CALL( fuel_, save_state( _ ) ).WillOnce( Return( fw::Result<>{} ) );
    EXPECT_CALL( pmic_, ship_mode() ).WillOnce( Return( fw::Result<>{} ) );
    EXPECT_TRUE( power_.check() );
}

TEST_F( PowerTest, PowersOffWithoutAClient )
{
    battery_reads( low );
    EXPECT_CALL( pmic_, read_battery() ).Times( 2 );
    ON_CALL( client_, send_progressor( _ ) ).WillByDefault( Return( std::unexpected( std::errc::not_connected ) ) );

    ASSERT_TRUE( power_.check() );
    ASSERT_TRUE( power_.check() );

    EXPECT_CALL( pmic_, ship_mode() ).WillOnce( Return( fw::Result<>{} ) );
    EXPECT_TRUE( power_.check() );
}

TEST_F( PowerTest, AFailedShipModeGoesBackToMonitoring )
{
    battery_reads( low );
    EXPECT_CALL( pmic_, read_battery() ).Times( 3 );
    ASSERT_TRUE( power_.check() );
    ASSERT_TRUE( power_.check() );
    EXPECT_CALL( pmic_, ship_mode() ).WillOnce( Return( std::unexpected( std::errc::io_error ) ) );

    EXPECT_EQ( power_.check(), std::unexpected( std::errc::io_error ) );
    EXPECT_EQ( power_.next_check(), power_manager::check_interval );

    // Starts over: the next low reading is confirmed again before powering off.
    ASSERT_TRUE( power_.check() );
    EXPECT_EQ( power_.next_check(), power_manager::confirm_delay );
}

TEST_F( PowerTest, ChargingNeverPowersOff )
{
    battery_reads( { .millivolts = 3100, .charge = hal::ChargeState::constant_current, .external_power = true } );
    EXPECT_CALL( pmic_, read_battery() ).Times( 3 );

    for( int i = 0; i < 3; ++i ) {
        ASSERT_TRUE( power_.check() );
        EXPECT_EQ( power_.next_check(), power_manager::check_interval );
    }
    EXPECT_TRUE( sent_.empty() );
}

} // namespace
```
