## CMakeLists.txt
```
# SPDX-License-Identifier: Apache-2.0

cmake_minimum_required(VERSION 3.20.0)

find_package(Zephyr REQUIRED HINTS $ENV{ZEPHYR_BASE})
project(test_fw)

target_compile_options(app PRIVATE -Werror)

target_sources(app PRIVATE
    src/test_error.cpp
    src/test_channel_ref.cpp
    src/test_scoped_lock.cpp
    src/test_queue_ref.cpp
    src/test_settings.cpp
)
```

## prj.conf
```kconfig
# GoogleTest unit test of the lib/fw helpers. zbus runs for real (native_sim).
CONFIG_GTEST=y

CONFIG_CPP=y
CONFIG_STD_CPP23=y
CONFIG_REQUIRES_FULL_LIBCPP=y
CONFIG_CPP_EXCEPTIONS=n
CONFIG_CPP_RTTI=n

CONFIG_ASSERT=y
CONFIG_BOOT_BANNER=n

CONFIG_ZBUS=y

# fw::settings on native_sim's simulated flash (storage_partition), ZMS backend.
CONFIG_FLASH=y
CONFIG_FLASH_MAP=y
CONFIG_ZMS=y
CONFIG_SETTINGS=y
CONFIG_SETTINGS_ZMS=y

# gtest/gmock need more stack and heap than Zephyr's defaults.
CONFIG_MAIN_STACK_SIZE=32768
CONFIG_HEAP_MEM_POOL_SIZE=131072
```

## src/test_channel_ref.cpp
```c
/**
 * @file test_channel_ref.cpp
 * @brief Unit tests for fw::ChannelRef against real zbus channels.
 *
 * SPDX-License-Identifier: Apache-2.0
 */

#include <zephyr/zbus/zbus.h>

#include <cstdint>
#include <fw/channel_ref.hpp>
#include <gtest/gtest.h>
#include <memory>
#include <system_error>

namespace
{

struct Sample {
    std::int32_t value;
    bool flag;
};

struct NotAMessage {
    std::unique_ptr<int> owned; // Owning member: not memcpy-safe.
};

static_assert( fw::ZbusMessage<Sample> );
static_assert( !fw::ZbusMessage<NotAMessage> );

} // namespace

ZBUS_CHAN_DEFINE( sample_chan, Sample, nullptr, nullptr, ZBUS_OBSERVERS_EMPTY, ZBUS_MSG_INIT( 0 ) );
ZBUS_CHAN_DEFINE( listened_chan, Sample, nullptr, nullptr, ZBUS_OBSERVERS_EMPTY, ZBUS_MSG_INIT( 0 ) );
// Never published, so it always holds its initial message.
ZBUS_CHAN_DEFINE( untouched_chan, Sample, nullptr, nullptr, ZBUS_OBSERVERS_EMPTY, ZBUS_MSG_INIT(.value = 7, .flag = true ) );

namespace
{

constexpr fw::ChannelRef<Sample> sample{ sample_chan };
constexpr fw::ChannelRef<Sample> untouched{ untouched_chan };
constexpr fw::ChannelRef<Sample> listened{ listened_chan };

Sample seen_by_listener{};

void on_listened( const zbus_channel *chan )
{
    if( listened.is( chan ) ) {
        seen_by_listener = listened.const_msg();
    }
}

} // namespace

ZBUS_LISTENER_DEFINE( test_listener, on_listened );
ZBUS_CHAN_ADD_OBS( listened_chan, test_listener, 0 );

namespace
{

TEST( ChannelRefTest, ReadReturnsInitialMessage )
{
    auto msg = untouched.read( K_NO_WAIT );

    ASSERT_TRUE( msg );
    EXPECT_EQ( msg->value, 7 );
    EXPECT_TRUE( msg->flag );
}

TEST( ChannelRefTest, PublishThenReadRoundTrips )
{
    ASSERT_TRUE( sample.publish( { .value = -42, .flag = true }, K_NO_WAIT ) );

    auto msg = sample.read( K_NO_WAIT );

    ASSERT_TRUE( msg );
    EXPECT_EQ( msg->value, -42 );
    EXPECT_TRUE( msg->flag );
}

TEST( ChannelRefTest, IsMatchesOnlyItsOwnChannel )
{
    EXPECT_TRUE( sample.is( &sample_chan ) );
    EXPECT_FALSE( sample.is( &untouched_chan ) );
    EXPECT_EQ( &sample.native(), &sample_chan );
}

} // namespace

namespace
{

TEST( ChannelRefTest, ListenerSeesPublishedMessageViaConstMsg )
{
    ASSERT_TRUE( listened.publish( { .value = 99, .flag = true }, K_NO_WAIT ) );

    EXPECT_EQ( seen_by_listener.value, 99 );
    EXPECT_TRUE( seen_by_listener.flag );
}

} // namespace
```

## src/test_error.cpp
```c
/**
 * @file test_error.cpp
 * @brief Unit tests for the fw::Result error model and Zephyr code conversions.
 *
 * SPDX-License-Identifier: Apache-2.0
 */

#include <cerrno>
#include <fw/error.hpp>
#include <gtest/gtest.h>
#include <system_error>

namespace
{

TEST( ErrorTest, CheckTreatsZeroAndPositiveAsSuccess )
{
    EXPECT_TRUE( fw::err::check( 0 ) );
    EXPECT_TRUE( fw::err::check( 5 ) );
}

TEST( ErrorTest, CheckMapsNegativeErrnoToErrc )
{
    auto ret = fw::err::check( -EIO );

    ASSERT_FALSE( ret );
    EXPECT_EQ( ret.error(), std::errc::io_error );
}

TEST( ErrorTest, ConversionsRoundTrip )
{
    EXPECT_EQ( fw::err::from_zephyr( -ENODEV ), std::errc::no_such_device );
    EXPECT_EQ( fw::err::to_zephyr( std::errc::no_such_device ), -ENODEV );
    EXPECT_EQ( fw::err::to_zephyr( fw::err::from_zephyr( -EAGAIN ) ), -EAGAIN );
}

} // namespace
```

## src/test_queue_ref.cpp
```c
/**
 * @file test_queue_ref.cpp
 * @brief Unit tests for fw::QueueRef against a real k_msgq.
 *
 * SPDX-License-Identifier: Apache-2.0
 */

#include <zephyr/kernel.h>

#include <cstdint>
#include <fw/queue_ref.hpp>
#include <gtest/gtest.h>
#include <system_error>

namespace
{

struct Item {
    std::uint8_t id;
    std::int16_t value;
};

} // namespace

K_MSGQ_DEFINE( test_msgq, sizeof( Item ), 2, alignof( Item ) );

namespace
{

constexpr fw::QueueRef<Item> queue{ test_msgq };

class QueueRefTest : public ::testing::Test
{
protected:
    void TearDown() override
    {
        k_msgq_purge( &test_msgq );
    }
};

TEST_F( QueueRefTest, GetReturnsItemsInOrder )
{
    ASSERT_TRUE( queue.put( { .id = 1, .value = -5 }, K_NO_WAIT ) );
    ASSERT_TRUE( queue.put( { .id = 2, .value = 7 }, K_NO_WAIT ) );
    EXPECT_EQ( queue.size(), 2U );

    auto first = queue.get( K_NO_WAIT );
    auto second = queue.get( K_NO_WAIT );

    ASSERT_TRUE( first );
    ASSERT_TRUE( second );
    EXPECT_EQ( first->id, 1 );
    EXPECT_EQ( first->value, -5 );
    EXPECT_EQ( second->id, 2 );
    EXPECT_EQ( queue.size(), 0U );
}

TEST_F( QueueRefTest, PutFailsWithoutBlockingWhenFull )
{
    ASSERT_TRUE( queue.put( { .id = 1, .value = 0 }, K_NO_WAIT ) );
    ASSERT_TRUE( queue.put( { .id = 2, .value = 0 }, K_NO_WAIT ) );

    auto ret = queue.put( { .id = 3, .value = 0 }, K_NO_WAIT );

    ASSERT_FALSE( ret );
    EXPECT_EQ( ret.error(), std::errc::no_message );
}

TEST_F( QueueRefTest, GetFailsWhenEmpty )
{
    auto ret = queue.get( K_NO_WAIT );

    ASSERT_FALSE( ret );
    EXPECT_EQ( ret.error(), std::errc::no_message );
}

TEST_F( QueueRefTest, GetTimesOut )
{
    auto ret = queue.get( K_MSEC( 10 ) );

    ASSERT_FALSE( ret );
    EXPECT_EQ( ret.error(), std::errc::resource_unavailable_try_again );
}

} // namespace
```

## src/test_scoped_lock.cpp
```c
/**
 * @file test_scoped_lock.cpp
 * @brief Unit tests for fw::ScopedLock against a real k_mutex.
 *
 * SPDX-License-Identifier: Apache-2.0
 */

#include <zephyr/kernel.h>

#include <fw/error.hpp>
#include <fw/scoped_lock.hpp>
#include <gtest/gtest.h>
#include <system_error>

K_MUTEX_DEFINE( test_mutex );

namespace
{

fw::Result<> fail_while_locked()
{
    fw::ScopedLock const lock{ test_mutex };
    if( test_mutex.lock_count == 1 ) {
        return std::unexpected( std::errc::io_error );
    }
    return {};
}

TEST( ScopedLockTest, HoldsMutexForScope )
{
    {
        fw::ScopedLock const lock{ test_mutex };
        EXPECT_EQ( test_mutex.lock_count, 1U );
        EXPECT_EQ( test_mutex.owner, k_current_get() );
    }
    EXPECT_EQ( test_mutex.lock_count, 0U );
}

TEST( ScopedLockTest, UnlocksOnEarlyReturn )
{
    EXPECT_FALSE( fail_while_locked() );
    EXPECT_EQ( test_mutex.lock_count, 0U );
}

} // namespace
```

## src/test_settings.cpp
```c
/**
 * @file test_settings.cpp
 * @brief Unit tests for fw::settings against real Zephyr settings (ZMS on native_sim's flash simulator).
 *
 * SPDX-License-Identifier: Apache-2.0
 */

#include <array>
#include <cstdint>
#include <fw/settings.hpp>
#include <gtest/gtest.h>
#include <system_error>

namespace
{

struct Point {
    float raw;
    float kg;
};

class SettingsTest : public ::testing::Test
{
protected:
    void SetUp() override
    {
        ASSERT_TRUE( fw::settings::init() );
    }

    void TearDown() override
    {
        for( const char *key : { "test/factor", "test/point", "test/id", "test/id_suffix", "test/id/backup" } ) {
            (void)fw::settings::erase( key );
        }
    }
};

TEST_F( SettingsTest, LoadFailsWhenNothingStored )
{
    auto value = fw::settings::load<float>( "test/factor" );

    ASSERT_FALSE( value );
    EXPECT_EQ( value.error(), std::errc::no_such_file_or_directory );
}

TEST_F( SettingsTest, SaveThenLoadRoundTrips )
{
    ASSERT_TRUE( fw::settings::save( "test/factor", 0.109F ) );
    ASSERT_TRUE( fw::settings::save( "test/point", Point{ .raw = 1234.5F, .kg = 20.0F } ) );

    auto factor = fw::settings::load<float>( "test/factor" );
    auto point = fw::settings::load<Point>( "test/point" );

    ASSERT_TRUE( factor );
    EXPECT_FLOAT_EQ( *factor, 0.109F );
    ASSERT_TRUE( point );
    EXPECT_FLOAT_EQ( point->raw, 1234.5F );
    EXPECT_FLOAT_EQ( point->kg, 20.0F );
}

TEST_F( SettingsTest, SaveOverwrites )
{
    ASSERT_TRUE( fw::settings::save( "test/factor", 1.0F ) );
    ASSERT_TRUE( fw::settings::save( "test/factor", 2.0F ) );

    EXPECT_FLOAT_EQ( *fw::settings::load<float>( "test/factor" ), 2.0F );
}

TEST_F( SettingsTest, LoadRejectsValueOfAnotherSize )
{
    ASSERT_TRUE( fw::settings::save( "test/factor", std::uint32_t{ 7 } ) );

    auto value = fw::settings::load<std::uint16_t>( "test/factor" );

    ASSERT_FALSE( value );
    EXPECT_EQ( value.error(), std::errc::invalid_argument );
}

TEST_F( SettingsTest, EraseRemovesValue )
{
    ASSERT_TRUE( fw::settings::save( "test/factor", 1.0F ) );

    ASSERT_TRUE( fw::settings::erase( "test/factor" ) );

    EXPECT_EQ( fw::settings::load<float>( "test/factor" ).error(), std::errc::no_such_file_or_directory );
}

TEST_F( SettingsTest, KeysWithACommonPrefixAreSeparate )
{
    using Id = std::array<std::uint8_t, 6>;
    Id const id{ 1, 2, 3, 4, 5, 6 };
    ASSERT_TRUE( fw::settings::save( "test/id", id ) );
    ASSERT_TRUE( fw::settings::save( "test/id_suffix", std::uint8_t{ 9 } ) );

    EXPECT_EQ( *fw::settings::load<Id>( "test/id" ), id );
    EXPECT_EQ( *fw::settings::load<std::uint8_t>( "test/id_suffix" ), 9 );
}

TEST_F( SettingsTest, LoadIgnoresKeysBelowIt )
{
    ASSERT_TRUE( fw::settings::save( "test/id/backup", std::uint8_t{ 7 } ) );

    // Only a key below "test/id" is stored: "test/id" itself is not.
    EXPECT_EQ( fw::settings::load<std::uint8_t>( "test/id" ).error(), std::errc::no_such_file_or_directory );

    ASSERT_TRUE( fw::settings::save( "test/id", std::uint8_t{ 3 } ) );
    EXPECT_EQ( *fw::settings::load<std::uint8_t>( "test/id" ), 3 );
}

} // namespace
```
