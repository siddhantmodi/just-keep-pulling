## CMakeLists.txt
```
# SPDX-License-Identifier: Apache-2.0

cmake_minimum_required(VERSION 3.20.0)

find_package(Zephyr REQUIRED HINTS $ENV{ZEPHYR_BASE})
project(app_template)

# Application code builds warning-free; dependencies keep their own flags.
target_compile_options(app PRIVATE -Werror)

target_sources(app PRIVATE src/main.cpp)

# zbus channels: the contracts shared by every layer
add_subdirectory_ifdef(CONFIG_ZBUS src/channels)

# Services: one subsystem or peripheral each, no thread of their own
add_subdirectory_ifdef(CONFIG_APP_LED_SVC src/services/led_svc)
add_subdirectory_ifdef(CONFIG_APP_TEMP_SVC src/services/temp_svc)
add_subdirectory_ifdef(CONFIG_APP_BLE_SVC src/services/ble_svc)

# Managers: own a thread and an event queue; the only callers of single-threaded services
add_subdirectory_ifdef(CONFIG_APP_MANAGER src/managers/app_manager)
```

## Kconfig
```
# SPDX-License-Identifier: Apache-2.0

menu "Zephyr"
source "Kconfig.zephyr"
endmenu

module = APP_MAIN
module-str = app_template
source "subsys/logging/Kconfig.template.log_config"

menu "Services"
rsource "src/services/led_svc/Kconfig"
rsource "src/services/temp_svc/Kconfig"
rsource "src/services/ble_svc/Kconfig"
endmenu

menu "Managers"
rsource "src/managers/app_manager/Kconfig"
endmenu
```

## prj.conf
```kconfig
# C++23 without exceptions or RTTI. Full libstdc++ provides <expected>, <span>, ...
CONFIG_CPP=y
CONFIG_STD_CPP23=y
CONFIG_REQUIRES_FULL_LIBCPP=y
CONFIG_CPP_EXCEPTIONS=n
CONFIG_CPP_RTTI=n

CONFIG_LOG=y
CONFIG_GPIO=y
CONFIG_SENSOR=y
CONFIG_ZBUS=y

# Bluetooth LE peripheral, one connection, open (unpaired) GATT access
CONFIG_BT=y
CONFIG_BT_PERIPHERAL=y
CONFIG_BT_DEVICE_NAME="Just Keep Pulling"
CONFIG_BT_MAX_CONN=1

# Application components
CONFIG_APP_LED_SVC=y
CONFIG_APP_TEMP_SVC=y
CONFIG_APP_MANAGER=y
CONFIG_APP_BLE_SVC=y

# Name shown in the NCS boot banner
CONFIG_NCS_APPLICATION_BOOT_BANNER_STRING="app_template"
```

## boards/nrf54l15dk_nrf54l15_cpuapp.overlay
```dts
/* SPDX-License-Identifier: Apache-2.0 */

/ {
	aliases {
		die-temp = &temp;
	};
};
```

## src/main.cpp
```c
/**
 * @file main.cpp
 * @brief app_template entry point.
 *
 * SPDX-License-Identifier: Apache-2.0
 */

#include "app_manager.hpp"
#include "ble_svc.hpp"
#include "led_svc.hpp"
#include "temp_svc.hpp"

#include <zephyr/app_version.h>
#include <zephyr/logging/log.h>

#include <cstdlib>
#include <fw/error.hpp>

LOG_MODULE_REGISTER( app_template, CONFIG_APP_MAIN_LOG_LEVEL );

int main()
{
    LOG_INF( "app_template v%s", APP_VERSION_STRING );

    if( auto ret = led_svc::led().init(); !ret ) {
        LOG_ERR( "LED service init failed: %d", fw::err::to_zephyr( ret.error() ) );
        return 0;
    }

    if( auto ret = temp_svc::temperature().init(); !ret ) {
        LOG_ERR( "temperature service init failed: %d", fw::err::to_zephyr( ret.error() ) );
        return 0;
    }

    if( auto centicelsius = temp_svc::temperature().read_centicelsius(); centicelsius ) {
        int const magnitude = std::abs( *centicelsius );
        LOG_INF( "die temperature: %s%d.%02d C", *centicelsius < 0 ? "-" : "", magnitude / 100, magnitude % 100 );
    }

    if( auto ret = app_manager::start(); !ret ) {
        LOG_ERR( "app manager start failed: %d", fw::err::to_zephyr( ret.error() ) );
        return 0;
    }

    if( auto ret = ble_svc::init(); !ret ) {
        LOG_ERR( "BLE service init failed: %d", fw::err::to_zephyr( ret.error() ) );
        return 0;
    }

    return 0;
}
```
