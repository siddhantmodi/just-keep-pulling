## dts/bindings/sensor/jkp,temperature-emul.yaml
```yaml
# SPDX-License-Identifier: Apache-2.0

description: |
  Emulated temperature sensor for native_sim. Reports SENSOR_CHAN_DIE_TEMP
  through the Zephyr sensor API, so apps use the same code as on hardware.
  Tests change the value or inject errors with <jkp/drivers/temperature_emul.h>.

compatible: "jkp,temperature-emul"

include: sensor-device.yaml

properties:
  millicelsius:
    type: int
    default: 25000
    description: Initial temperature in milli-degrees Celsius.
```

## lib/Kconfig
```kconfig
# SPDX-License-Identifier: Apache-2.0

menu "just-keep-pulling libraries"

rsource "fw/Kconfig"
rsource "hal/Kconfig"
rsource "gtest/Kconfig"

endmenu
```

## lib/fw/Kconfig
```kconfig
# SPDX-License-Identifier: Apache-2.0

config FW_CPP
	bool "C++ firmware helpers (fw::)"
	depends on CPP
	default y
	help
	  C++23 helpers under <fw/...>: the fw::Result error model and Zephyr
	  error-code conversions, fw::ChannelRef (typed zbus channels, needs
	  CONFIG_ZBUS), fw::QueueRef, fw::ScopedLock and fw::settings (typed
	  load/save, needs CONFIG_SETTINGS).
```

## lib/gtest/Kconfig
```kconfig
# SPDX-License-Identifier: Apache-2.0

config GTEST
	bool "GoogleTest/GoogleMock unit test framework"
	depends on CPP
	select REQUIRES_FULL_LIBCPP
	select TEST
	help
	  Compile GoogleTest + GoogleMock (the 'googletest' west project) into
	  the image. Intended for native_sim unit tests run through Twister's
	  gtest harness. Not for production firmware images.

config GTEST_MAIN
	bool "Provide a GoogleTest main() entry point"
	depends on GTEST
	default y
	help
	  Provide main() that initializes GoogleMock and runs all tests.
	  Disable to supply your own entry point.
```

## lib/hal/Kconfig
```kconfig
# SPDX-License-Identifier: Apache-2.0

config FW_HAL
	bool "Hardware capability interfaces (hal::)"
	depends on FW_CPP
	default y
	help
	  Header-only interfaces for hardware capabilities (digital output,
	  temperature sensor, ...) with thin Zephyr implementations. Components
	  take these interfaces so unit tests can inject mocks.
```
